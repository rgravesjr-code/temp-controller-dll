VERSION "TempCtl v2 - generated by tools/make_tempctl_dbc.py"

NS_ :

BS_:

BU_: TempCtl

BO_ 2566848766 TempCtl: 50 TempCtl
 SG_ Setpoint : 0|16@1+ (0.03125,-273) [-273|1734.96875] "degC" Vector__XXX
 SG_ DeadbandHi : 16|16@1+ (0.03125,0) [0|2007.96875] "degC" Vector__XXX
 SG_ DeadbandLo : 32|16@1+ (0.03125,0) [0|2007.96875] "degC" Vector__XXX
 SG_ HiLimit : 48|16@1+ (0.03125,-273) [-273|1734.96875] "degC" Vector__XXX
 SG_ LoLimit : 64|16@1+ (0.03125,-273) [-273|1734.96875] "degC" Vector__XXX
 SG_ ErrorTimeoutMs : 80|32@1+ (1,0) [0|4211081215] "ms" Vector__XXX
 SG_ DeadbandTimeoutMs : 112|32@1+ (1,0) [0|4211081215] "ms" Vector__XXX
 SG_ FilterPoints : 144|8@1+ (1,0) [1|64] "" Vector__XXX
 SG_ Temp2Enable : 152|2@1+ (1,0) [0|1] "" Vector__XXX
 SG_ Temp2Tolerance : 160|16@1+ (0.03125,0) [0|2007.96875] "degC" Vector__XXX
 SG_ FeedbackEnable : 176|2@1+ (1,0) [0|1] "" Vector__XXX
 SG_ Temp1 : 184|16@1+ (0.03125,-273) [-273|1734.96875] "degC" Vector__XXX
 SG_ Temp2 : 200|16@1+ (0.03125,-273) [-273|1734.96875] "degC" Vector__XXX
 SG_ HeaterFeedback : 216|2@1+ (1,0) [0|1] "" Vector__XXX
 SG_ CoolerFeedback : 218|2@1+ (1,0) [0|1] "" Vector__XXX
 SG_ HeatingCmd : 220|2@1+ (1,0) [0|1] "" Vector__XXX
 SG_ CoolingCmd : 222|2@1+ (1,0) [0|1] "" Vector__XXX
 SG_ ErrorStatus : 224|16@1+ (1,0) [0|1023] "" Vector__XXX
 SG_ TempStatus : 240|4@1+ (1,0) [0|8] "" Vector__XXX
 SG_ ControlTemp : 248|16@1+ (0.03125,-273) [-273|1734.96875] "degC" Vector__XXX
 SG_ Temp1Filtered : 264|16@1+ (0.03125,-273) [-273|1734.96875] "degC" Vector__XXX
 SG_ Temp2Filtered : 280|16@1+ (0.03125,-273) [-273|1734.96875] "degC" Vector__XXX
 SG_ HiBand : 296|16@1+ (0.03125,-273) [-273|1734.96875] "degC" Vector__XXX
 SG_ LoBand : 312|16@1+ (0.03125,-273) [-273|1734.96875] "degC" Vector__XXX
 SG_ ErrorRemainMs : 328|32@1+ (1,0) [0|4211081215] "ms" Vector__XXX
 SG_ DbRemainMs : 360|32@1+ (1,0) [0|4211081215] "ms" Vector__XXX
 SG_ ActiveSensor : 392|2@1+ (1,0) [1|2] "" Vector__XXX

CM_ BO_ 2566848766 "TempCtl controller state (TcStep output array), PGN 65280 Proprietary B, J1939 BAM";
CM_ SG_ 2566848766 Setpoint "Setpoint. Heating runs until >= Setpoint, cooling until <= Setpoint";
CM_ SG_ 2566848766 DeadbandHi "Offset above Setpoint: HiBand = Setpoint + DeadbandHi";
CM_ SG_ 2566848766 DeadbandLo "Offset below Setpoint: LoBand = Setpoint - DeadbandLo";
CM_ SG_ 2566848766 HiLimit "Sensor above this for ErrorTimeout has failed (hi)";
CM_ SG_ 2566848766 LoLimit "Sensor below this for ErrorTimeout has failed (lo)";
CM_ SG_ 2566848766 ErrorTimeoutMs "Limit / bad reading / disagreement / feedback countdown";
CM_ SG_ 2566848766 DeadbandTimeoutMs "Time outside the band before a relay engages";
CM_ SG_ 2566848766 FilterPoints "Moving-average length per sensor";
CM_ SG_ 2566848766 Temp2Enable "Second sensor present: rationality check and failover";
CM_ SG_ 2566848766 Temp2Tolerance "|Temp1Filtered - Temp2Filtered| above this for ErrorTimeout -> disagree";
CM_ SG_ 2566848766 FeedbackEnable "Compare relay feedback inputs with the commands";
CM_ SG_ 2566848766 Temp1 "Sensor 1 raw reading (primary)";
CM_ SG_ 2566848766 Temp2 "Sensor 2 raw reading";
CM_ SG_ 2566848766 HeaterFeedback "Measured heater relay state";
CM_ SG_ 2566848766 CoolerFeedback "Measured cooler relay state";
CM_ SG_ 2566848766 HeatingCmd "Heating relay command";
CM_ SG_ 2566848766 CoolingCmd "Cooling relay command";
CM_ SG_ 2566848766 ErrorStatus "Bit mask: b0 T1 hi, b1 T1 lo, b2 T1 bad, b3 T2 hi, b4 T2 lo, b5 T2 bad, b6 disagree, b7 heater feedback, b8 cooler feedback, b9 config";
CM_ SG_ 2566848766 TempStatus "Controller state";
CM_ SG_ 2566848766 ControlTemp "Filtered value of the active sensor that drives control";
CM_ SG_ 2566848766 Temp1Filtered "Moving average of Temp1";
CM_ SG_ 2566848766 Temp2Filtered "Moving average of Temp2 (not available when Temp2 is disabled)";
CM_ SG_ 2566848766 HiBand "Setpoint + DeadbandHi";
CM_ SG_ 2566848766 LoBand "Setpoint - DeadbandLo";
CM_ SG_ 2566848766 ErrorRemainMs "Smallest running error countdown, 0 when none";
CM_ SG_ 2566848766 DbRemainMs "Remaining deadband countdown, 0 when idle or running";
CM_ SG_ 2566848766 ActiveSensor "Sensor whose filtered value is ControlTemp";
BA_DEF_ BO_  "VFrameFormat" ENUM  "StandardCAN","ExtendedCAN","reserved","J1939PG";
BA_DEF_ BO_  "GenMsgCycleTime" INT 0 3600000;
BA_DEF_ BO_  "GenMsgSendType" ENUM  "Cyclic","NotUsed","NotUsed","NotUsed","NotUsed","NotUsed","NotUsed","IfActive","NoMsgSendType";
BA_DEF_  "ProtocolType" STRING ;
BA_DEF_DEF_  "VFrameFormat" "J1939PG";
BA_DEF_DEF_  "GenMsgCycleTime" 0;
BA_DEF_DEF_  "GenMsgSendType" "NoMsgSendType";
BA_DEF_DEF_  "ProtocolType" "J1939";
BA_ "GenMsgCycleTime" BO_ 2566848766 1000;
BA_ "GenMsgSendType" BO_ 2566848766 0;
VAL_ 2566848766 Temp2Enable 1 "Enabled" 0 "Disabled" ;
VAL_ 2566848766 FeedbackEnable 1 "Enabled" 0 "Disabled" ;
VAL_ 2566848766 HeaterFeedback 1 "On" 0 "Off" ;
VAL_ 2566848766 CoolerFeedback 1 "On" 0 "Off" ;
VAL_ 2566848766 HeatingCmd 1 "On" 0 "Off" ;
VAL_ 2566848766 CoolingCmd 1 "On" 0 "Off" ;
VAL_ 2566848766 TempStatus 8 "FilterWarmup" 7 "Degraded" 6 "Stopped" 5 "ErrorPending" 4 "Cooling" 3 "CoolPending" 2 "Heating" 1 "HeatPending" 0 "InBand" ;
VAL_ 2566848766 ActiveSensor 2 "Sensor2" 1 "Sensor1" ;
