VERSION "TempCtl v3 diagnostics - generated by tools/make_tempctl_dbc.py"

NS_ :

BS_:

BU_: TempCtl

BO_ 2566848766 TempCtl: 55 TempCtl
 SG_ ControlTemp : 0|16@1+ (0.03125,-273) [-273|1734.96875] "deg" Vector__XXX
 SG_ ActiveSensor : 16|4@1+ (1,0) [1|2] "" Vector__XXX
 SG_ Temp1Raw : 24|16@1+ (0.03125,-273) [-273|1734.96875] "deg" Vector__XXX
 SG_ Temp2Raw : 40|16@1+ (0.03125,-273) [-273|1734.96875] "deg" Vector__XXX
 SG_ Temp2Corrected : 56|16@1+ (0.03125,-273) [-273|1734.96875] "deg" Vector__XXX
 SG_ Temp1Avg : 72|16@1+ (0.03125,-273) [-273|1734.96875] "deg" Vector__XXX
 SG_ Temp2Avg : 88|16@1+ (0.03125,-273) [-273|1734.96875] "deg" Vector__XXX
 SG_ HiBand : 104|16@1+ (0.03125,-273) [-273|1734.96875] "deg" Vector__XXX
 SG_ LoBand : 120|16@1+ (0.03125,-273) [-273|1734.96875] "deg" Vector__XXX
 SG_ InitialHcFlag : 136|2@1+ (1,0) [0|1] "" Vector__XXX
 SG_ DeadbandRemainMs : 144|32@1+ (1,0) [0|4211081215] "ms" Vector__XXX
 SG_ AtSetPtRemainMs : 176|32@1+ (1,0) [0|4211081215] "ms" Vector__XXX
 SG_ CompareRemainMs : 208|32@1+ (1,0) [0|4211081215] "ms" Vector__XXX
 SG_ HeaterFbRemainMs : 240|32@1+ (1,0) [0|4211081215] "ms" Vector__XXX
 SG_ CoolerFbRemainMs : 272|32@1+ (1,0) [0|4211081215] "ms" Vector__XXX
 SG_ Temp1OorAccumMs : 304|32@1+ (1,0) [0|4211081215] "ms" Vector__XXX
 SG_ Temp2OorAccumMs : 336|32@1+ (1,0) [0|4211081215] "ms" Vector__XXX
 SG_ Temp1OorEventsPerHour : 368|16@1+ (1,0) [0|64254] "" Vector__XXX
 SG_ Temp2OorEventsPerHour : 384|16@1+ (1,0) [0|64254] "" Vector__XXX
 SG_ Status : 400|8@1+ (1,0) [0|250] "" Vector__XXX
 SG_ Warning : 408|8@1+ (1,0) [0|250] "" Vector__XXX
 SG_ DoHeater : 416|2@1+ (1,0) [0|1] "" Vector__XXX
 SG_ DoCooler : 418|2@1+ (1,0) [0|1] "" Vector__XXX
 SG_ AppliedFilterPoints : 424|8@1+ (1,0) [1|64] "" Vector__XXX
 SG_ ZoneInitialized : 432|2@1+ (1,0) [0|1] "" Vector__XXX

CM_ BO_ 2566848766 "TempCtl v3 zone diagnostics (TcGetDiag array), PGN 65280 Proprietary B, J1939 BAM";
CM_ SG_ 2566848766 ControlTemp "Raw value control acts on (sensor 2 offset-corrected); not available before the first CheckTemp or while the reading is NaN";
CM_ SG_ 2566848766 ActiveSensor "Sensor in control";
CM_ SG_ 2566848766 Temp1Raw "Last temp1 as supplied";
CM_ SG_ 2566848766 Temp2Raw "Last temp2 as supplied (not available when Temp2Enable = 0)";
CM_ SG_ 2566848766 Temp2Corrected "temp2 + Temp2Offset";
CM_ SG_ 2566848766 Temp1Avg "Moving average of in-range temp1 samples (comparison only)";
CM_ SG_ 2566848766 Temp2Avg "Moving average of in-range corrected temp2 samples";
CM_ SG_ 2566848766 HiBand "Setpoint + DeadbandHi";
CM_ SG_ 2566848766 LoBand "Setpoint - DeadbandLo";
CM_ SG_ 2566848766 InitialHcFlag "First heat-up or cool-down complete (gates the sensor comparison)";
CM_ SG_ 2566848766 DeadbandRemainMs "ms before a relay engages; 0 when not counting";
CM_ SG_ 2566848766 AtSetPtRemainMs "ms before the running relay drops; 0 when not counting";
CM_ SG_ 2566848766 CompareRemainMs "ms to the disagreement fault; 0 when not counting";
CM_ SG_ 2566848766 HeaterFbRemainMs "ms to the heater feedback fault; 0 when not counting";
CM_ SG_ 2566848766 CoolerFbRemainMs "ms to the cooler feedback fault; 0 when not counting";
CM_ SG_ 2566848766 Temp1OorAccumMs "Sensor 1 out-of-range leaky accumulator; the sensor fails at ErrorTimeout";
CM_ SG_ 2566848766 Temp2OorAccumMs "Sensor 2 out-of-range leaky accumulator";
CM_ SG_ 2566848766 Temp1OorEventsPerHour "Sensor 1 in-range to out-of-range transitions in the last 60 minutes";
CM_ SG_ 2566848766 Temp2OorEventsPerHour "Sensor 2 in-range to out-of-range transitions in the last 60 minutes";
CM_ SG_ 2566848766 Status "Status code of the last CheckTemp (0..5 states, 10..16 faults)";
CM_ SG_ 2566848766 Warning "Warning code of the last CheckTemp (lowest active code)";
CM_ SG_ 2566848766 DoHeater "Last heater relay command";
CM_ SG_ 2566848766 DoCooler "Last cooler relay command";
CM_ SG_ 2566848766 AppliedFilterPoints "FilterPoints in use (1..64; an invalid setup value becomes 4)";
CM_ SG_ 2566848766 ZoneInitialized "1 once a setup has been loaded";
BA_DEF_ BO_  "VFrameFormat" ENUM  "StandardCAN","ExtendedCAN","reserved","J1939PG";
BA_DEF_ BO_  "GenMsgCycleTime" INT 0 3600000;
BA_DEF_ BO_  "GenMsgSendType" ENUM  "Cyclic","NotUsed","NotUsed","NotUsed","NotUsed","NotUsed","NotUsed","IfActive","NoMsgSendType";
BA_DEF_  "ProtocolType" STRING ;
BA_DEF_DEF_  "VFrameFormat" "J1939PG";
BA_DEF_DEF_  "GenMsgCycleTime" 0;
BA_DEF_DEF_  "GenMsgSendType" "NoMsgSendType";
BA_DEF_DEF_  "ProtocolType" "J1939";
BA_ "GenMsgCycleTime" BO_ 2566848766 1000;
BA_ "GenMsgSendType" BO_ 2566848766 0;
VAL_ 2566848766 ActiveSensor 2 "Sensor2" 1 "Sensor1" ;
VAL_ 2566848766 InitialHcFlag 1 "Complete" 0 "WarmUp" ;
VAL_ 2566848766 Status 16 "CoolerFBFault" 15 "HeaterFBFault" 14 "ConfigFault" 13 "TempDisagreeFault" 12 "BothSensorsFailed" 11 "Temp1FailLow" 10 "Temp1FailHigh" 5 "CoolPending" 4 "HeatPending" 3 "CoolerON" 2 "HeaterON" 1 "TempAtSetPt" 0 "TempCtrlDisabled" ;
VAL_ 2566848766 Warning 7 "ConfigInvalid" 6 "RunningOnTemp2" 5 "TempDisagree" 4 "CoolerFBMismatch" 3 "HeaterFBMismatch" 2 "Temp2OutOfRange" 1 "Temp1OutOfRange" 0 "NoWarning" ;
VAL_ 2566848766 DoHeater 1 "On" 0 "Off" ;
VAL_ 2566848766 DoCooler 1 "On" 0 "Off" ;
VAL_ 2566848766 ZoneInitialized 1 "Loaded" 0 "NoSetup" ;
